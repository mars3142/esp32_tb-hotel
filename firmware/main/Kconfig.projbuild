## firmware/main/Kconfig.projbuild
```kconfig
menu "Geocache Configuration"
    config GEO_WLED_DIN_PIN
        int "WLED Data In Pin"
        default 12
        help
            The number of the WLED data in pin.

    config GEO_BTN_PIN
        int "Button Pin"
        default 11
        help
            The number of the button pin.
endmenu
```

## firmware/sdkconfig.defaults
```kconfig
CONFIG_ESPTOOLPY_FLASHSIZE_4MB=y
CONFIG_ESPTOOLPY_FLASHSIZE="4MB"

CONFIG_BT_ENABLED=y
CONFIG_BT_NIMBLE_ENABLED=y
CONFIG_BT_NIMBLE_50_FEATURE_SUPPORT=n

CONFIG_PARTITION_TABLE_CUSTOM=y
CONFIG_PARTITION_TABLE_FILENAME="partitions.csv"
```
